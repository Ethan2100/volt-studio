// Generated by Volt. Edit the .volt file, not this one.

const int led = 13;
const int button = 2;
long presses = 0;
bool __lastRaw0 = false;
bool __stable0 = false;
unsigned long __changedAt0 = 0;

void setup() {
  Serial.begin(9600);
  pinMode(led, OUTPUT);
  pinMode(button, INPUT_PULLUP);
  presses = 0;
  Serial.println("Ready! Press the button.");
}

void loop() {
  // when button pressed (line 11)
  {
    bool raw = (digitalRead(button) == LOW);
    if (raw != __lastRaw0) { __lastRaw0 = raw; __changedAt0 = millis(); }
    if (millis() - __changedAt0 > 30 && raw != __stable0) {
      __stable0 = raw;
      if (__stable0) {
        presses = presses + 1;
        Serial.println(String("Pressed ") + String(presses) + " times");
        if ((presses % 5) == 0) {
          Serial.println(String("That's ") + String(presses) + "!");
          for (long __i1 = 0; __i1 < 3; __i1++) {
            digitalWrite(led, HIGH);
            delay(100);
            digitalWrite(led, LOW);
            delay(100);
          }
        }
      }
    }
  }
}
