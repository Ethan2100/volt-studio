// Generated by Volt. Edit the .volt file, not this one.

const int led = 13;
const int buzzer = 8;
const int button = 2;
long rolls = 0;
bool __lastRaw2 = false;
bool __stable2 = false;
unsigned long __changedAt2 = 0;

long blinkTimes(long count);
long beep(long pitch);

// fn blinkTimes (line 10)
long blinkTimes(long count) {
  for (long __i0 = 0; __i0 < count; __i0++) {
    digitalWrite(led, HIGH);
    delay(200);
    digitalWrite(led, LOW);
    delay(200);
  }
  return 0;
}

// fn beep (line 19)
long beep(long pitch) {
  { long __ms1 = 120; tone(buzzer, pitch, __ms1); delay(__ms1); }
  return 0;
}

void setup() {
  Serial.begin(9600);
  pinMode(led, OUTPUT);
  pinMode(buzzer, OUTPUT);
  pinMode(button, INPUT_PULLUP);
  randomSeed(analogRead(A0));
  rolls = 0;
}

void loop() {
  // when button pressed (line 23)
  {
    bool raw = (digitalRead(button) == LOW);
    if (raw != __lastRaw2) { __lastRaw2 = raw; __changedAt2 = millis(); }
    if (millis() - __changedAt2 > 30 && raw != __stable2) {
      __stable2 = raw;
      if (__stable2) {
        rolls = rolls + 1;
        long dice = random(1, (6) + 1);
        Serial.println(String("Roll ") + String(rolls) + ": you got " + String(dice));
        beep(400 + (dice * 100));
        blinkTimes(dice);
        if (dice == 6) {
          Serial.println("SIX! Lucky roll!");
          for (long __i3 = 0; __i3 < 3; __i3++) {
            beep(1200);
            delay(80);
          }
        }
      }
    }
  }
}
