// Generated by Volt. Edit the .volt file, not this one.

const int joyX = A0;
const int motor[4] = {8, 9, 10, 11};
long __pos_motor = 0;
long __rpm_motor = 10;
long resting = 0;

long __clamp(long v, long lo, long hi) { return v < lo ? lo : (v > hi ? hi : v); }
const byte __half[8][4] = {{1,0,0,0},{1,1,0,0},{0,1,0,0},{0,1,1,0},{0,0,1,0},{0,0,1,1},{0,0,0,1},{1,0,0,1}};
void __stepper_coils(const int *p, long pos) { int s = ((pos % 8) + 8) % 8; for (int i = 0; i < 4; i++) digitalWrite(p[i], __half[s][i]); }
void __stepper_move(const int *p, long &pos, long rpm, long halfSteps) {
  unsigned long wait = 60000000UL / (4096UL * (unsigned long)(rpm < 1 ? 1 : rpm));
  long dir = halfSteps > 0 ? 1 : -1;
  for (long i = 0; i < halfSteps * dir; i++) { pos += dir; __stepper_coils(p, pos); delayMicroseconds(wait); }
}
long __round_div(long a, long b) { return a >= 0 ? (a + b / 2) / b : -((-a + b / 2) / b); }
void __stepper_to(const int *p, long &pos, long rpm, long angle) {
  long now = ((pos % 4096) + 4096) % 4096;
  long target = __round_div(((angle % 360) + 360) % 360 * 4096L, 360);
  long diff = target - now;
  if (diff > 2048) diff -= 4096;
  if (diff < -2048) diff += 4096;
  __stepper_move(p, pos, rpm, diff);
}
void __stepper_off(const int *p) { for (int i = 0; i < 4; i++) digitalWrite(p[i], LOW); }

void setup() {
  Serial.begin(9600);
  for (int __p = 0; __p < 4; __p++) pinMode(motor[__p], OUTPUT);
  resting = true;
}

void loop() {
  // forever (line 10)
  long x = analogRead(joyX);
  if (x > 600) {
    __rpm_motor = __clamp(map(x, 600, 1023, 2, 15), 1, 15);
    __stepper_move(motor, __pos_motor, __rpm_motor, (8) * 2);
    resting = false;
  } else if (x < 420) {
    __rpm_motor = __clamp(map(x, 420, 0, 2, 15), 1, 15);
    __stepper_move(motor, __pos_motor, __rpm_motor, (-(8)) * 2);
    resting = false;
  } else if (!(resting)) {
    __stepper_off(motor);
    Serial.println(String("Stopped at ") + String(((__pos_motor % 4096 + 4096) % 4096 * 360 + 2048) / 4096 % 360) + " degrees");
    resting = true;
  }
}
